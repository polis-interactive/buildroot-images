## configs/polis_rpi4_musl_erofs_defconfig
```kconfig
BR2_aarch64=y
BR2_cortex_a72=y
BR2_ARM_FPU_VFPV4=y
BR2_TOOLCHAIN_EXTERNAL=y
BR2_TOOLCHAIN_EXTERNAL_BOOTLIN=y
BR2_TOOLCHAIN_EXTERNAL_BOOTLIN_AARCH64_MUSL_STABLE=y
BR2_SHARED_STATIC_LIBS=y
BR2_POLIS_PREFER_STATIC=y
BR2_GLOBAL_PATCH_DIR="board/raspberrypi/patches $(BR2_EXTERNAL_POLIS_PATH)/patches/musl"
BR2_DOWNLOAD_FORCE_CHECK_HASHES=y
BR2_TARGET_GENERIC_HOSTNAME="polis-rpi4"
BR2_TARGET_GENERIC_ISSUE="Polis Raspberry Pi 4 test image"
# BR2_TARGET_GENERIC_GETTY is not set
# BR2_TARGET_GENERIC_REMOUNT_ROOTFS_RW is not set
BR2_ROOTFS_OVERLAY="$(BR2_EXTERNAL_POLIS_PATH)/board/polis/rpi4/rootfs-overlay $(BR2_EXTERNAL_POLIS_PATH)/board/polis/rpi4/filesystems/rootfs-overlay"
BR2_ROOTFS_POST_BUILD_SCRIPT="$(BR2_EXTERNAL_POLIS_PATH)/board/polis/rpi4/check-static.py $(BR2_EXTERNAL_POLIS_PATH)/board/polis/rpi4/install-smoke.py"
BR2_ROOTFS_POST_IMAGE_SCRIPT="support/scripts/genimage.sh"
BR2_ROOTFS_POST_SCRIPT_ARGS="-c $(BR2_EXTERNAL_POLIS_PATH)/board/polis/rpi4/filesystems/genimage-erofs.cfg"
BR2_LINUX_KERNEL=y
BR2_LINUX_KERNEL_CUSTOM_TARBALL=y
BR2_LINUX_KERNEL_CUSTOM_TARBALL_LOCATION="$(call github,raspberrypi,linux,21b410140c47ffab5668399f6f143c7d7b935c8b)/linux-21b410140c47ffab5668399f6f143c7d7b935c8b.tar.gz"
BR2_LINUX_KERNEL_DEFCONFIG="bcm2711"
BR2_LINUX_KERNEL_CONFIG_FRAGMENT_FILES="$(BR2_EXTERNAL_POLIS_PATH)/board/polis/rpi4/linux.fragment $(BR2_EXTERNAL_POLIS_PATH)/board/polis/rpi4/filesystems/linux-storage.fragment $(BR2_EXTERNAL_POLIS_PATH)/board/polis/rpi4/filesystems/linux-erofs.fragment"
BR2_LINUX_KERNEL_DTS_SUPPORT=y
BR2_LINUX_KERNEL_INTREE_DTS_NAME="broadcom/bcm2711-rpi-4-b"
BR2_LINUX_KERNEL_NEEDS_HOST_OPENSSL=y
BR2_PACKAGE_BUSYBOX_CONFIG_FRAGMENT_FILES="$(BR2_EXTERNAL_POLIS_PATH)/board/polis/rpi4/busybox.fragment $(BR2_EXTERNAL_POLIS_PATH)/board/polis/rpi4/busybox-static.fragment"
BR2_PACKAGE_BUSYBOX_SHOW_OTHERS=y
BR2_PACKAGE_XZ=y
BR2_PACKAGE_BRCMFMAC_SDIO_FIRMWARE_RPI=y
BR2_PACKAGE_BRCMFMAC_SDIO_FIRMWARE_RPI_WIFI=y
BR2_PACKAGE_RPI_FIRMWARE=y
BR2_PACKAGE_RPI_FIRMWARE_VARIANT_PI4=y
BR2_PACKAGE_RPI_FIRMWARE_CONFIG_FILE="$(BR2_EXTERNAL_POLIS_PATH)/board/polis/rpi4/config.txt"
BR2_PACKAGE_RPI_FIRMWARE_CMDLINE_FILE="$(BR2_EXTERNAL_POLIS_PATH)/board/polis/rpi4/filesystems/cmdline-erofs.txt"
BR2_PACKAGE_IWD=y
# BR2_PACKAGE_NETWORK_MANAGER is not set
BR2_PACKAGE_OPENRESOLV=y
# BR2_PACKAGE_WPA_SUPPLICANT is not set
BR2_PACKAGE_KMOD=y
BR2_PACKAGE_KMOD_TOOLS=y
# BR2_TARGET_ROOTFS_EXT2 is not set
BR2_TARGET_ROOTFS_EROFS=y
BR2_TARGET_ROOTFS_EROFS_LZ4HC=y
BR2_TARGET_ROOTFS_EROFS_LZ4HC_LEVEL=9
# BR2_TARGET_ROOTFS_TAR is not set
BR2_PACKAGE_HOST_DOSFSTOOLS=y
BR2_PACKAGE_HOST_GENIMAGE=y
BR2_PACKAGE_HOST_E2FSPROGS=y
BR2_PACKAGE_HOST_KMOD_XZ=y
BR2_PACKAGE_HOST_MTOOLS=y
```

## package/Config.in
```kconfig
source "$BR2_EXTERNAL_POLIS_PATH/package/polis-boot-diagnostics/Config.in"
source "$BR2_EXTERNAL_POLIS_PATH/package/polis-firstboot/Config.in"
source "$BR2_EXTERNAL_POLIS_PATH/package/polis-wifi-setupd/Config.in"
source "$BR2_EXTERNAL_POLIS_PATH/package/polis-dtmerge/Config.in.host"
source "$BR2_EXTERNAL_POLIS_PATH/package/polis-dtoverlay/Config.in"

config BR2_POLIS_RPI4_VL805_FIRMWARE
	bool "Use Pi 4 boot firmware with the VL805 decompressor fix"
	depends on BR2_PACKAGE_RPI_FIRMWARE_VARIANT_PI4
	help
	  Replace start4.elf and fixup4.dat with the pinned upstream fix for
	  VL805 initialization when the bootloader has not initialized USB.
	  Keep the existing kernel, DTBs and overlays. No EEPROM update.

config BR2_POLIS_KERNEL_LOGO
	bool "Embed the preconverted Polis kernel logo"
	depends on BR2_LINUX_KERNEL
	help
	  Copy the supplied 512x512 CLUT224 PPM into the kernel before
	  compilation. No host image converter is needed during builds.

config BR2_POLIS_KERNEL_ENTRY
	bool "Emit the Polis Linux entry benchmark marker"
	depends on BR2_aarch64
	depends on BR2_LINUX_KERNEL
	help
	  Instrument Linux entry for the Pico UART benchmark. Profile builds
	  select this explicitly through the kernel-entry-marker group.

config BR2_POLIS_PREFER_STATIC
	bool "Prefer static executables in the Polis image"
	depends on BR2_TOOLCHAIN_USES_MUSL
	depends on BR2_SHARED_STATIC_LIBS
	help
	  Link the core boot executables statically while retaining
	  shared-library support for packages such as BlueZ. Requires
	  the Polis musl board's patches and BusyBox config fragment.

config BR2_POLIS_SPLASH_SCREEN
	bool "Polis persistent Rust DRM splash"
	depends on BR2_LINUX_KERNEL && BR2_aarch64
	help
	  Build the private Rust DRM client into VC4 for screen development.
	  Needs host rustc, matching rust-src, bindgen and libclang; adds no
	  userspace runtime dependencies. The profile disables fbdev/fbcon.
```

## package/polis-boot-diagnostics/Config.in
```kconfig
config BR2_PACKAGE_POLIS_BOOT_DIAGNOSTICS
	bool "polis-boot-diagnostics"
	depends on BR2_aarch64
	depends on BR2_PACKAGE_HOST_RUSTC_TARGET_ARCH_SUPPORTS
	depends on BR2_TOOLCHAIN_HAS_THREADS
	select BR2_PACKAGE_HOST_RUSTC
	select BR2_PACKAGE_BOOT_DIAGNOSTICS_TOOLS
	help
	  Collect one immutable kernel/firmware diagnostic capture per boot.
	  Runs in the background, waits for writable /data, saves and flushes
	  the capture, then exits. Uses no GPIO pins or UART device.
	  Requires the package's install.py post-build hook.
	  Includes vclog and vcgencmd for the saved firmware diagnostics.

# Internal upstream-source helper; enabled through the collector.
config BR2_PACKAGE_BOOT_DIAGNOSTICS_TOOLS
	bool
	depends on BR2_aarch64
```

## package/polis-dtmerge/Config.in.host
```kconfig
config BR2_PACKAGE_HOST_POLIS_DTMERGE
	bool "host polis-dtmerge"
	help
	  Raspberry Pi's dtmerge utility for applying firmware overlays on
	  the build host. Installs no utilities into the target image.
```

## package/polis-dtoverlay/Config.in
```kconfig
config BR2_PACKAGE_POLIS_DTOVERLAY
	bool "polis-dtoverlay"
	depends on !BR2_STATIC_LIBS
	select BR2_PACKAGE_DTC
	help
	  Raspberry Pi's dtoverlay utility for runtime device-tree
	  overlays. Installs only dtoverlay; libfdt is supplied by the
	  dtc library package. Requires kernel OF/configfs overlay
	  support and accessible .dtbo files.
```

## package/polis-firmware-tools/Config.in
```kconfig
config BR2_PACKAGE_POLIS_FIRMWARE_TOOLS
	bool "polis-firmware-tools"
	depends on BR2_aarch64
	help
	  Raspberry Pi's vclog and vcgencmd utilities for reading retained
	  VideoCore logs and bootloader configuration after Linux starts.
	  These tools do not enable UART tracing or update the EEPROM.
```

## package/polis-firstboot/Config.in
```kconfig
config BR2_PACKAGE_POLIS_FIRSTBOOT
	bool "polis-firstboot"
	depends on BR2_aarch64
	depends on BR2_USE_MMU
	depends on BR2_USE_WCHAR
	depends on BR2_TOOLCHAIN_HAS_THREADS
	depends on !BR2_STATIC_LIBS
	select BR2_PACKAGE_PYTHON3
	select BR2_PACKAGE_BOOT_DIAGNOSTICS_TOOLS
	help
	  Once-only Pi 4 EEPROM configuration. Never resizes storage.
	  Profile builds enable this by default.
	  Uses same-release EEPROM firmware, persistent recovery
	  records, and at most one automatic EEPROM update attempt per
	  settings set.
```

## package/polis-gpio-test/Config.in
```kconfig
config BR2_PACKAGE_POLIS_GPIO_TEST
	bool "polis-gpio-test"
	depends on BR2_aarch64
	depends on BR2_PACKAGE_HOST_RUSTC_TARGET_ARCH_SUPPORTS
	depends on BR2_TOOLCHAIN_HAS_THREADS
	select BR2_PACKAGE_HOST_RUSTC
	select BR2_PACKAGE_POLIS_FIRMWARE_TOOLS
	help
	  Early Tokio/RPPAL GPIO blink test for the Polis Pi 4.
	  Blinks BCM GPIO26 once UART opens without transmitting, then
	  BCM GPIO19 once boot diagnostics are saved to the mounted /data
	  partition. Both toggle independently every 500 ms. GPIO startup
	  runs before storage and rcS; log export waits in the background.
	  Needs built-in GPIO access and the install-gpio-test.py hook.
```

## package/polis-graphics-usb/Config.in
```kconfig
config BR2_PACKAGE_POLIS_GRAPHICS_USB
	bool "Polis screen graphics USB workers"
	depends on BR2_aarch64
	depends on BR2_TOOLCHAIN_USES_MUSL
	depends on BR2_INIT_BUSYBOX
	depends on BR2_ROOTFS_DEVICE_CREATION_DYNAMIC_MDEV
	help
	  Install the prepared hdmi-graphics-hello executable and a libc-only
	  mdev event receiver supervising one worker per matching Pico.
	  Prepare the app with package/polis-graphics-usb/prepare.py first.
```

## package/polis-wifi-setupd/Config.in
```kconfig
config BR2_PACKAGE_POLIS_WIFI_SETUPD
	bool "polis-wifi-setupd"
	depends on BR2_aarch64
	depends on BR2_TOOLCHAIN_USES_MUSL
	depends on BR2_INIT_BUSYBOX
	depends on BR2_PACKAGE_HOST_RUSTC_TARGET_ARCH_SUPPORTS
	depends on BR2_USE_MMU
	depends on BR2_USE_WCHAR
	depends on BR2_TOOLCHAIN_HAS_THREADS
	depends on BR2_TOOLCHAIN_HAS_SYNC_4
	depends on BR2_TOOLCHAIN_HEADERS_AT_LEAST_4_12
	depends on !BR2_STATIC_LIBS
	select BR2_PACKAGE_HOST_RUSTC
	select BR2_PACKAGE_IWD
	select BR2_PACKAGE_DBUS
	select BR2_PACKAGE_READLINE
	help
	  Wi-Fi provisioning daemon and browser portal, built from release
	  0.1.3, with the portal supplied by the matching release asset.
	  Initial integration supports AArch64 musl with BusyBox init.
	  Requires persistent /data and /var/lib, iwd network configuration,
	  Wi-Fi firmware and a supplied image password.
	  Select the wifi-setupd profile group for the image integration.

	  https://github.com/polis-interactive/wifi-setupd
```
